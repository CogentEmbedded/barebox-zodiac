## drivers/hwmon/Kconfig
```kconfig
#
# HWMON class/drivers configuration
#

menuconfig HWMON
	tristate "Hardware Monitoring support"
	default y
	help
	  Hardware monitoring devices let you monitor the hardware
	  health of a system. If you want this support you should say
	  Y here and also to the specific driver(s) for your sensors
	  chip(s) below.

if HWMON

config SENSORS_LM75
	tristate "National Semiconductor LM75 and compatibles"
	depends on I2C
	help
	  If you say yes here you get support for one common type of
	  temperature sensor chip, with models including:

		- National Semiconductor LM75, LM75A

config SENSORS_IMX_THERMAL
       tristate "Temperature sensor driver for Freescale i.MX SoCs"
       help
         Support for Temperature Monitor (TEMPMON) found on Freescale
         i.MX SoCs.

endif # HWMON
```
